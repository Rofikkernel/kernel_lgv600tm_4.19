## block/Kconfig.lfs
```kconfig
config LFS_BLOCK
	bool
	default y if LFS_COMMON

config LFS_BLOCK_RQ
	bool
	default y if LFS_COMMON
```

## drivers/input/fingerprint/Kconfig
```kconfig
#
# Fingerprints driver configuration
#
menuconfig INPUT_FINGERPRINT
	bool "FingerPrints"
	help
	  Say Y here, and a list of supported fingerprints will be displayed.
	  This option doesn't affect the kernel.

	  If unsure, say Y.

if INPUT_FINGERPRINT

config BBK_ET713
	tristate "Egis ET713 fingerprint drvier support"
	help
	  Say Y here to enable et713 fingerprint driver support!
endif
```

## drivers/mmc/Kconfig.lfs
```kconfig
config LFS_MMC
	bool
	default y if LFS_COMMON

config LFS_MMC_CLK_SCALE_DISABLE
	bool
	default y if LFS_COMMON

config LFS_MMC_TRAY_EVENT
	bool
	default y if LFS_COMMON

config LFS_MMC_SD_WAKE_ENABLE
	bool
	default y if LFS_COMMON
```

## drivers/nfc/cxd224x/Kconfig
```kconfig
#
# Nxp Nci protocol (I2C) devices
#

#config NFC_PN553_DEVICES
#       bool "Nxp pn553 NCI protocol driver (I2C) devices"
#       default y
#       ---help---
#         You'll have to say Y if your computer contains an I2C device that
#         you want to use under Linux.
#
#         You can say N here if you don't have any SPI connected to your computer.

### LGE_START ###

config CXD224X_NFC
    tristate "CXD224X NFC driver"
    depends on I2C
    select CRC_CCITT
    default n
    ---help---
      Say yes if you want cxd224x Near Field Communication driver.
      This is for i2c connected version. If unsure, say N here.

      To compile this driver as a module, choose m here. The module will
      be called cxd224x-i2c.

config CXD224X_NFC_VEN
    tristate "CXD224X NFC VEN"
    depends on CXD224X_NFC
    default n
    ---help---
      Say yes if you want to use cxd224x NFC VEN(enable voltage) control.
      If unsure, say N here.

config CXD224X_NFC_RST
    tristate "CXD224X NFC RST"
    depends on CXD224X_NFC
    default y
    ---help---
      Say yes if you want to use cxd224x NFC RST(external XRST pin) control.

config CXD224X_NFC_SERVICE_MODE
    tristate "CXD224X NFC Service Mode"
    depends on CXD224X_NFC
    default n
    ---help---
      Say yes if you want to use cxd224x NFC Service Mode control.

### LGE_END ###
```

## drivers/scsi/Kconfig.lfs
```kconfig
config LFS_SCSI
	bool
	default y if LFS_COMMON

config LFS_SCSI_DEVICE_IDENTIFIER
	bool
	default y if LFS_COMMON

config LFS_SCSI_USB_HOST_NOTIFY
	bool
	default y if LFS_COMMON
```

## drivers/scsi/ufs/Kconfig.lfs
```kconfig
config LFS_UFS
	bool
	default y if LFS_COMMON

config LFS_UFS_SYSFS_COMMON
	bool
	default y if LFS_COMMON

config LFS_UFSDBG_TUNABLES
	bool
	default n
```

## drivers/soc/qcom/lge/Kconfig
```kconfig
config MACH_LGE
	bool "Machine LGE"
	help
		Support for machine LGE.

menu "LGE Board Selection"

config LGE_PM
	tristate "KONA(SM8250) LGE POWER Feature"
	depends on SPMI || MSM_SPMI
	help
	  Say Y here to enable support for KONA(SM8250)/PM8250 chip lge feature.
	  Power Management, Battery charging, Battery Monitoring System
	  with battery FET and fuel gauge.

config LGE_PM_DEBUG
	tristate "Support LGE PM Debug feature"
	default n
	depends on MACH_LGE
	help
	  LGE PM Debug Feature

config MACH_KONA_TIMELM
	bool "KONA TIMELM"
	depends on ARCH_KONA
	select MACH_LGE
	select LGE_DM_VERITY_RECOVERY
	help
		Support for the Qualcomm KONA(SM8250) TIMELM device.

config MACH_KONA_TIMELM_LAO_COM
	bool "KONA TIMELM_LAO_COM"
	depends on ARCH_KONA
	select MACH_LGE
	select LGE_DM_VERITY_RECOVERY
	help
		Support for the Qualcomm KONA(SM8250) TIMELM_LAO_COM device.

config MACH_KONA_TIMELM_LAO_LDU
	bool "KONA TIMELM_LAO_LDU"
	depends on ARCH_KONA
	select MACH_LGE
	select LGE_DM_VERITY_RECOVERY
	help
	Support for the Qualcomm KONA(SM8250) TIMELM_LAO_LDU device.

config MACH_KONA_TIMELM_DCM_JP
	bool "KONA TIMELM_DCM_JP"
	depends on ARCH_KONA
	select LGE_DM_VERITY_RECOVERY
	select MACH_LGE
	help
		Support for the Qualcomm KONA(SM8250) TIMELM_DCM_JP device.

config MACH_KONA_TIMELM_SB_JP
	bool "KONA TIMELM_SB_JP"
	depends on ARCH_KONA
	select LGE_DM_VERITY_RECOVERY
	select MACH_LGE
	help
		Support for the Qualcomm KONA(SM8250) TIMELM_SB_JP device.

config LGE_PM_PRM
	tristate "Support LGE Power resource manager"
	help
	  LGE power resource manager

endmenu

menu "LGE Specific Patches"

config LGE_HANDLE_PANIC
	tristate "Support LGE Crash Handler"
	default n
	depends on MACH_LGE
	select LGE_HANDLE_PANIC_RPMH_TIMEOUT
	help
	  LGE Crash Handler

config LGE_HANDLE_PANIC_RPMH_TIMEOUT
	tristate "Support LGE Crash Handler RPMH Timeout"
	default n
	depends on LGE_HANDLE_PANIC
	help
	  LGE Crash Handler

config LGE_BOOTLOADER_LOG
	tristate "Support LGE bootloader log"
	default n
	depends on MACH_LGE
	help
	  LGE bootloader log

config LGE_PSTORE_BACKUP
        tristate "Support pstore backup"
        default y
        depends on MACH_LGE
        help
          Ramoops region is backed up to pstore partition

config LGE_BOOTLOADER_TIME_CHECKER
	tristate "Supprt bootloader(LK, SBL) time"
	default n
	depends on MACH_LGE
	help
	  Check LK, SBL booting time at
	  sys/module/lge_bootloader_time_checker/parameters/lk_time
	  sys/module/lge_bootloader_time_checker/parameters/sbl_time

config LGE_QSDL_SUPPORT
	tristate "Support for Quality Statistics Data Logging"
	default n
	depends on MACH_LGE
	help
	  QSDL is a feature which notify infomation for quality statistics
	  data logging of device.

config LGE_PM_SMPL_COUNTER
	tristate "Support LGE SMPL COUNTER feature"
	default n
	depends on MACH_LGE
	help
	  Say y to enable smpl_cnt module, that count when
	  booted by SMPL

config LGE_DM_VERITY_RECOVERY
	tristate "Support dm verity corrupt recovery"
	default n
	depends on MACH_LGE
	help
	  Sometimes, dm-bufio has invalid data. If data is corrupted,
	  try to recover data.

config LGE_ONE_BINARY_SKU
	tristate "Support LGE One binary sku carrier"
	default n
	depends on MACH_LGE
	help
	  LGE One Binary sku carrier

config LGE_MME_BUS
        bool "boost interface for LGE MME"
        depends on MACH_LGE
        help
          Say 'y' here to include support for the boost interface
          of msm bus to support LGE MME.

config LGE_MME_BOOST
        bool "booster for LGE MME"
        depends on LGE_MME_BUS
        help
          Say 'y' here to include support for the boost
          of msm bus to support LGE MME.

config LGE_MME_BOOST_LONG_TERM
        bool "Long term booster for LGE MME"
        depends on LGE_MME_BUS
        help
          Say 'y' here to include support for the long term boost
          of msm bus to support LGE MME.

config LGE_MME_BOOST_EBI
        bool "EBI Clock booster for LGE MME"
        depends on LGE_MME_BUS
        help
          Say 'y' here to include support for the ebi clock boost
          of msm bus to support LGE MME.

config LGE_MME_PM_QOS_DMA_LATENCY
        bool "PM QOS DMA latency for LGE MME"
        depends on LGE_MME_BUS
        help
          Say 'y' here to include support for PM QOS DMA Latency
          of msm bus to support LGE MME.

config LGE_MME_DRV
        tristate "Support WMC driver"
        depends on MACH_LGE
        default m
        help
          Say 'y' here to enable Wireless Magnetic Communication driver for LG pay

config LGE_POWEROFF_TIMEOUT
	bool "Support shutdown and reboot timeout"
	depends on MACH_LGE
	default y
	help
	  Say 'y" here to include support for shutdown and reboot timeout.

config LGE_DUAL_SCREEN
        bool "Support Dual Screen"
        depends on MACH_LGE
        help
          Say 'y" here to include support for dual screen.

config LGE_DISPLAY_DIMMING_BOOT_SUPPORT
        bool "Support dimming boot"
        depends on MACH_LGE
        help
          Say 'y" here to include support for dimming boot.

config LFS_COMMON
        bool "Support LGE Filesystem Kernel Feature"
        default y if MACH_LGE
        select NLS_UTF8
        help
          Say 'y' here to enable LGE Filesystem Features

endmenu

menu "LGE QFPROM Values"

config LGE_QFPROM_INTERFACE
	bool "Support qfprom interface"
	default n
	depends on MACH_LGE
	help
	  LGE QFPROM DRIVER.

endmenu
```

## fs/Kconfig.lfs
```kconfig
config LFS_SUSPEND_BGSYNC
	bool
	default y if LFS_COMMON

config LFS_ADAPTIVE_READAHEAD
	bool
	default y if LFS_COMMON

config LFS_IOSCHED_EXTENSION
	bool
	default y if LFS_COMMON

config LFS_IOSCHED_CFQ_PREEMPT
	bool
	default y if LFS_COMMON

config LFS_EXT4
	bool
	default y if LFS_COMMON

config LFS_SDCARDFS
	bool
	default y if LFS_COMMON

config LFS_FAT_FIX_BAD_FORMAT
	bool
	default y if LFS_COMMON
```
