// SPDX-License-Identifier: GPL-2.0-only
/*
 * Copyright (c) 2018-2019, The Linux Foundation. All rights reserved.
 */

&qupv3_se13_i2c {
	sw42000@28 {
		status = "disable";
		compatible = "lge,sw42000";

		reg = <0x28>;
		interrupt-parent = <&tlmm>;
		interrupts = <39 0x2008>;
		irqflags = <0x00000002>;

		vcl-gpio = <&tlmm 67 0x00>;
		//vdd-supply = <&pm8150a_l1>;
		reset-gpio = <&tlmm 38 0x00>;
		irq-gpio = <&tlmm 39 0x2008>;

		/* Caps */
		max_x = <1439>;
		max_y = <3119>;
		max_pressure = <0xff>;
		max_width_major = <3119>;
		max_width_minor = <3119>;
		max_orientation = <90>;
		max_id = <10>;
		hw_reset_delay = <40>;
		sw_reset_delay = <40>;

		/* Role */
		use_lpwg = <1>;
		use_lpwg_test = <1>;
		hide_coordinate = <0>;
		use_film_status = <1>;

		/* Firmware */
		fw_image = "touch/timelm/L0W60TIME_0_43.img";
		panel_spec = "touch/timelm/timelm_siw_limit.txt";
		panel_spec_mfts_folder = "touch/timelm/timelm_siw_limit_mfts.txt";

		/* Performance Test */
		use_perf_test = <1>;
		test_delay = <8>;
		test_pressure = <50>;
		test_width = <100>;
		click_test_x = <180>;
		click_test_y = <838>;
		v_drag_test_x = <144>;
		v_drag_test_start_y = <2103>;
		v_drag_test_end_y = <1216>;
		h_drag_test_start_x = <1163>;
		h_drag_test_end_x = <276>;
		h_drag_test_y = <2284>;
	};
	sw42902 {
		compatible = "lge,sw42902";
		reg = <0x28>;
		status = "disabled";
		interrupt-parent = <&tlmm>;
		interrupts = <39 0x2008>;
		irqflags = <0x00000002>;

		vdd-gpio = <&tlmm 68 0x00>;
		vcl-gpio = <&tlmm 67 0x00>;
		reset-gpio = <&tlmm 38 0x00>;
		irq-gpio = <&tlmm 39 0x2008>;

		/* caps */
		max_x = <1080>;
		max_y = <2460>;
		max_pressure = <0xff>;
		max_width_major = <2460>;
		max_width_minor = <2460>;
		max_orientation = <90>;
		max_id = <10>;
		hw_reset_delay = <90>;
		sw_reset_delay = <10>;

		/* role */
		use_lpwg = <1>;
		use_lpwg_test = <1>;
		hide_coordinate = <1>;
		use_activepen_status = <1>;
		use_film_status = <1>;
		use_dex_mode = <1>;

		/* firmware */
		fw_image = "touch/timelm/B3W68TIME_0_74.img",
			   "touch/timelm/B3W68DS3_0_16.img";

		panel_spec = "touch/timelm/Time_limit.txt";
		panel_spec_mfts_folder = "touch/timelm/Time_limit.txt";

		/* asc */
		use_asc = <0>;
		low_delta_thres = <350>;
		high_delta_thres = <600>;
		max_delta_cnt = <2>;

		/* Performance Test */
		use_perf_test = <1>;
		test_delay = <8>;
		test_pressure = <50>;
		test_width = <100>;
		click_test_x = <180>;
		click_test_y = <760>;
		v_drag_test_x = <144>;
		v_drag_test_start_y = <2003>;
		v_drag_test_end_y = <1116>;
		h_drag_test_start_x = <1163>;
		h_drag_test_end_x = <276>;
		h_drag_test_y = <2184>;
	};
};
