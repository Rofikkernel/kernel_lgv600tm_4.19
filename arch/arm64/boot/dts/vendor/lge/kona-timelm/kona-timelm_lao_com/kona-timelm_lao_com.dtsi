// SPDX-License-Identifier: GPL-2.0-only
/*
 * Copyright (c) 2018-2019, The Linux Foundation. All rights reserved.
 */

#include <dt-bindings/clock/qcom,gcc-kona.h>
#include <dt-bindings/clock/qcom,camcc-kona.h>
#include <dt-bindings/clock/qcom,rpmh.h>
#include <dt-bindings/interrupt-controller/arm-gic.h>
#include <dt-bindings/gpio/gpio.h>
#include <dt-bindings/input/input.h>

#include "../kona-timelm_common/kona-timelm_common.dtsi"
#include "kona-timelm_lao_com-pinctrl.dtsi"
#include "kona-timelm_lao_com-panel.dtsi"
#include "kona-timelm_lao_com-misc.dtsi"
#include "kona-timelm_lao_com-pm.dtsi"
#include "kona-timelm_lao_com-connectivity.dtsi"
#include "kona-timelm_lao_com-nfc.dtsi"
#include "kona-timelm_lao_com-mme.dtsi"
#include "kona-timelm_lao_com-tdmb.dtsi"
#include "kona-timelm_lao_com-touch.dtsi"
#include "kona-timelm_lao_com-fingerprint.dtsi"
#include "kona-timelm_lao_com-usb.dtsi"
#include "kona-timelm_lao_com-storage.dtsi"
#include "kona-timelm_lao_com-sar.dtsi"