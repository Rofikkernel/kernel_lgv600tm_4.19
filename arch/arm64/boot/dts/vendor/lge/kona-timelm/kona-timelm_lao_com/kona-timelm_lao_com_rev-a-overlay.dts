// SPDX-License-Identifier: GPL-2.0-only
/*
 * Copyright (c) 2018-2019, The Linux Foundation. All rights reserved.
 */

/dts-v1/;
/plugin/;

#include "kona-timelm_lao_com.dtsi"
#include "../kona-camera/kona-timelm-camera_reva.dtsi"
#include "kona-timelm_lao_com-sound.dtsi"

/ {
    model = "LG Electronics, Timelm_lao, rev_a";
    compatible = "qcom,kona-mtp", "qcom,kona", "qcom,mtp";
    qcom,board-id = <0x00060008 0>;
};

&lge_usb_debugger {
    lge,always-console-enable;
};
