// SPDX-License-Identifier: GPL-2.0-only
/*
 * Copyright (c) 2018-2019, The Linux Foundation. All rights reserved.
 */

#include <dt-bindings/clock/qcom,gcc-kona.h>
#include <dt-bindings/clock/qcom,camcc-kona.h>
#include <dt-bindings/clock/qcom,rpmh.h>
#include <dt-bindings/interrupt-controller/arm-gic.h>
#include <dt-bindings/gpio/gpio.h>
#include <dt-bindings/input/input.h>

#include "../kona-timelm_common/kona-timelm_common.dtsi"
#include "kona-timelm_sb_jp-pinctrl.dtsi"
#include "kona-timelm_sb_jp-panel.dtsi"
#include "kona-timelm_sb_jp-misc.dtsi"
#include "kona-timelm_sb_jp-pm.dtsi"
#include "kona-timelm_sb_jp-connectivity.dtsi"
#include "kona-timelm_sb_jp-nfc.dtsi"
#include "kona-timelm_sb_jp-mme.dtsi"
#include "kona-timelm_sb_jp-tdmb.dtsi"
#include "kona-timelm_sb_jp-touch.dtsi"
#include "kona-timelm_sb_jp-fingerprint.dtsi"
#include "kona-timelm_sb_jp-usb.dtsi"
#include "kona-timelm_sb_jp-storage.dtsi"
#include "kona-timelm_sb_jp-sar.dtsi"