// SPDX-License-Identifier: GPL-2.0-only
/*
 * Copyright (c) 2018-2019, The Linux Foundation. All rights reserved.
 */

#include "../../../qcom/kona-sde-display.dtsi"

#include "../kona-timelm_common/kona-timelm_common-panel.dtsi"
