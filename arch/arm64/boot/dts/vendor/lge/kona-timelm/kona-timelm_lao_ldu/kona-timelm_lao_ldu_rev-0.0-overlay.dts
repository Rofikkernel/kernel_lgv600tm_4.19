// SPDX-License-Identifier: GPL-2.0-only
/*
 * Copyright (c) 2018-2019, The Linux Foundation. All rights reserved.
 */

/dts-v1/;
/plugin/;

#include "kona-timelm_lao_ldu.dtsi"
#include "../kona-camera/kona-timelm-camera_rev0.dtsi"
#include "kona-timelm_lao_ldu-sound.dtsi"

/ {
    model = "LG Electronics, Timelm_lao, rev_0.0";
    compatible = "qcom,kona-mtp", "qcom,kona", "qcom,mtp";
    qcom,board-id = <8 0>;
};

&lge_usb_debugger {
    lge,always-console-enable;
};

&mdm0 {
    status = "disabled";
};

