// SPDX-License-Identifier: GPL-2.0-only
/*
 * Copyright (c) 2018-2019, The Linux Foundation. All rights reserved.
 */

#include "../kona-timelm_common/kona-timelm_common-nfc.dtsi"

&qupv3_se1_i2c {
	status = "ok";
	qcom,clk-freq-out = <1000000>;
	nq@28 {
		status = "disabled";
	};

	pn547@28 {
		compatible = "nxp,pn547";
		reg = <0x28>;
		status = "ok";
		nxp,gpio_sda = <&tlmm 4 0x00>;
		nxp,gpio_scl = <&tlmm 5 0x00>;
		nxp,gpio_ven = <&tlmm 6 0x00>;
		nxp,gpio_mode = <&tlmm 110 0x00>;
		nxp,gpio_irq = <&tlmm 111 0x00>;
		nxp,i2c-pull-up = <1>;
		qcom,clk-src = "BBCLK2";
		interrupt-parent = <&tlmm>;
		interrupts = <111 0>;
		interrupt-names = "nfc_irq";
	};
};
