// SPDX-License-Identifier: GPL-2.0-only
/*
 * Copyright (c) 2018-2019, The Linux Foundation. All rights reserved.
 */

#include <dt-bindings/clock/qcom,gcc-kona.h>
#include <dt-bindings/clock/qcom,camcc-kona.h>
#include <dt-bindings/clock/qcom,rpmh.h>
#include <dt-bindings/interrupt-controller/arm-gic.h>
#include <dt-bindings/gpio/gpio.h>
#include <dt-bindings/input/input.h>

#include "../kona-timelm_common/kona-timelm_common.dtsi"
#include "kona-timelm_lao_ldu-pinctrl.dtsi"
#include "kona-timelm_lao_ldu-panel.dtsi"
#include "kona-timelm_lao_ldu-misc.dtsi"
#include "kona-timelm_lao_ldu-sar.dtsi"
#include "kona-timelm_lao_ldu-pm.dtsi"
#include "kona-timelm_lao_ldu-connectivity.dtsi"
//#include "kona-timelm_lao_ldu-nfc.dtsi"
#include "kona-timelm_lao_ldu-mme.dtsi"
#include "kona-timelm_lao_ldu-tdmb.dtsi"
#include "kona-timelm_lao_ldu-touch.dtsi"
#include "kona-timelm_lao_ldu-fingerprint.dtsi"
#include "kona-timelm_lao_ldu-usb.dtsi"
#include "kona-timelm_lao_ldu-storage.dtsi"
