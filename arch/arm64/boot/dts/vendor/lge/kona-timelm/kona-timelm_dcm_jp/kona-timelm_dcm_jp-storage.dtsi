// SPDX-License-Identifier: GPL-2.0-only
/*
 * Copyright (c) 2018-2019, The Linux Foundation. All rights reserved.
 */

#include "../kona-timelm_common/kona-timelm_common-storage.dtsi"

&firmware {
	android {
		compatible = "android,firmware";
		fstab {
			compatible = "android,fstab";
			OP {
				status = "disabled";
			};
		};
	};
};
