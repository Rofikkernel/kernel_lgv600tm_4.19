// SPDX-License-Identifier: GPL-2.0-only
/*
 * Copyright (c) 2018-2019, The Linux Foundation. All rights reserved.
 */

#include "../kona-timelm_common/kona-timelm_common-connectivity.dtsi"

&qupv3_se6_4uart {
    status = "ok";
};

&vendor {
    bluetooth: bt_qca6390 {
        compatible = "qca,qca6390";
        pinctrl-names = "default";
        pinctrl-0 = <&bt_en_sleep>;
        qca,bt-reset-gpio = <&tlmm 21 0>; /* BT_EN */
        qca,bt-vdd-aon-supply = <&pm8150_s6>;
        qca,bt-vdd-dig-supply = <&pm8150_s6>;
        qca,bt-vdd-rfa1-supply = <&pm8150_s5>;
        qca,bt-vdd-rfa2-supply = <&pm8150a_s8>;

        qca,bt-vdd-aon-voltage-level = <950000 950000>;
        qca,bt-vdd-dig-voltage-level = <950000 950000>;
        qca,bt-vdd-rfa1-voltage-level = <1900000 1900000>;
        qca,bt-vdd-rfa2-voltage-level = <1350000 1350000>;
    };
};

&wil6210 {
    status = "ok";
};

